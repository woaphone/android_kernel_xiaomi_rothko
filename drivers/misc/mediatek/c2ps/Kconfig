## drivers/thermal/mediatek/Kconfig
```kconfig
config MTK_THERMAL
	tristate "MediaTek thermal drivers"
	depends on THERMAL_OF
	help
	  This is the option for MediaTek thermal software solutions.
	  Please enable corresponding options to get temperature
	  information from thermal sensors or turn on throttle
	  mechaisms for thermal mitigation.

if MTK_THERMAL

config MTK_SOC_THERMAL
	tristate "AUXADC temperature sensor driver for MediaTek SoCs"
	depends on HAS_IOMEM
	help
	  Enable this option if you want to get SoC temperature
	  information for MediaTek platforms.
	  This driver configures thermal controllers to collect
	  temperature via AUXADC interface.

config MTK_LVTS_THERMAL
        tristate "LVTS Thermal Driver for MediaTek SoCs"
        depends on HAS_IOMEM
        help
          Enable this option if you want to get SoC temperature
          information for supported MediaTek platforms.
          This driver configures LVTS (Low Voltage Thermal Sensor)
          thermal controllers to collect temperatures via ASIF
          (Analog Serial Interface).

config MTK_LVTS_MT6989
	tristate "MediaTek MT6989 LVTS thermal sensors"
	depends on HAS_IOMEM && NVMEM
	help
	  Read the firmware-initialized LVTS controllers on MT6989. The
	  driver uses the per-sensor eFuse calibration and exposes the SoC
	  maximum and individual sensors through the thermal subsystem.

config MTK_LVTS_THERMAL_DEBUGFS
       bool "LVTS thermal debugfs"
       depends on MTK_LVTS_THERMAL && DEBUG_FS
       help
         Enable this option to debug the internals of the device driver.

config MTK_BOARD_THERMAL
	tristate "MediaTek MT6685 TIA board thermistors"
	depends on HAS_IOMEM && THERMAL_OF
	help
	  Read board thermistors through the MT6685 TIA converter and
	  expose the device-tree thermal zones.

config MTK_PMIC_TEMP
	tristate "MediaTek MT6363/MT6373 PMIC temperature sensors"
	depends on IIO && NVMEM_MT635X_EFUSE && MEDIATEK_SPMI_PMIC_ADC
	help
	  Register the four calibrated AUXADC temperature sensors on each
	  MT6363 and MT6373 PMIC. The module is named pmic_temp.

config MTK_CHARGER_COOLING
	tristate "MediaTek MT6375 charger cooling"
	depends on MTK_CHARGER && CHARGER_MT6375
	help
	  Apply thermal cooling states as charging current limits through the
	  MediaTek charger manager. The module is named charger_cooling.

config MTK_BACKLIGHT_COOLING
	tristate "MediaTek display backlight cooling"
	depends on LEDS_MTK && LEDS_MTK_DISP
	help
	  Limit the MediaTek display backlight through its hardware brightness
	  control. The module is named backlight_cooling.

config XIAOMI_THERMAL_MESSAGE
	bool "Xiaomi thermal message interface"
	depends on MTK_THERMAL=y
	help
	  Expose the Xiaomi thermal daemon and framework message attributes
	  in the thermal class on boards with a thermal-message node.

endif
```

## net/rothko_minet/Kconfig
```kconfig
# SPDX-License-Identifier: GPL-2.0-only
config ROTHKO_MINET
	tristate "Rothko per-UID traffic accounting (minet)"
	depends on INET && IPV6 && NF_CONNTRACK
	help
	  Provide the minet Generic Netlink interface used by the Rothko
	  vendor daemon for per-UID TCP and UDP traffic accounting.
	  Accounting starts when the daemon adds a UID to monitor.
	  If built as a module, it will be called minet.
```

## sound/soc/mediatek/rothko-mt6989/Kconfig
```kconfig
# SPDX-License-Identifier: GPL-2.0-only
source "sound/soc/mediatek/rothko-mt6989/provider/adsp/Kconfig"
source "sound/soc/mediatek/rothko-mt6989/provider/audio_ipi/Kconfig"
source "sound/soc/mediatek/rothko-mt6989/provider/vow/Kconfig"

config SND_SOC_ROTHKO_MT6989
	bool "Xiaomi rothko MT6989 vendor audio"
	depends on ARCH_MEDIATEK && SND_SOC && I2C
	depends on MFD_MT6681
	select MTK_AUDIODSP_SUPPORT
	select MTK_ADSP_V2
	select MTK_AUDIO_IPI
	select MTK_VOW_SUPPORT
	select SND_SOC_COMPRESS
	select DEVICE_MODULES_SND_SOC_MEDIATEK
	select SND_SOC_MTK_SMART_PHONE
	select SND_SOC_MTK_SRAM
	select SND_SOC_MT6989
	select SND_SOC_MT6989_MT6681
	select SND_SOC_MT6681
	select SND_SOC_MT6681_ACCDET
	select SND_SOC_ROTHKO_AW882XX
	select SND_SOC_MTK_AUDIO_DSP
	select SND_SOC_MTK_OFFLOAD
	select MTK_ULTRASND_PROXIMITY
	help
	  Real MT6989 AFE, MT6681 codec, ADSP PCM/offload and SCP ultrasound
	  drivers for the stock rothko device tree and Android audio HAL.
	  The ADSP transport and MT6681 MFD providers must also be enabled.

config DEVICE_MODULES_SND_SOC_MEDIATEK
	bool

config SND_SOC_MTK_SMART_PHONE
	bool

config SND_SOC_MTK_SRAM
	bool

config SND_SOC_MT6989
	bool

config SND_SOC_MT6989_MT6681
	bool

config SND_SOC_MT6681
	bool

config SND_SOC_MT6681_ACCDET
	bool

config SND_SOC_MTK_AUDIO_DSP
	bool

config SND_SOC_MTK_OFFLOAD
	bool

config MTK_ULTRASND_PROXIMITY
	bool

config DEVICE_MODULES_SND_SOC_MTK_BTCVSD
	tristate "MT6989 vendor Bluetooth CVSD PCM"
	depends on SND_SOC_ROTHKO_MT6989

config MTK_SCP_AUDIO
	bool

config SND_SOC_ROTHKO_AW882XX
	bool
```
