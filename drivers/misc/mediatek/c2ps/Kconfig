## drivers/misc/mediatek/c2ps/Kconfig
```kconfig
# SPDX-License-Identifier: GPL-2.0
config MTK_C2PS
	bool "MediaTek MT6989 camera per-task performance control"
	depends on ARCH_MEDIATEK && PROC_FS && UCLAMP_TASK
	depends on ANDROID_VENDOR_HOOKS
	help
	  Expose the rothko camera HAL ioctl at /proc/c2ps/c2ps_ioctl.
	  Apply and restore fixed per-thread utilization clamps for registered
	  tasks. The HAL needs its stock node permissions and CAP_SYS_NICE.
	  ACTIVATE and ADD_TASK select only this fixed policy. Gear limits,
	  VIP controls, task-group tuning and adaptive inputs are unavailable.
	  Scene changes, VSYNC/CAMFPS and single-shot requests are unsupported.
```

## drivers/misc/mediatek/cm_mgr/Kconfig
```kconfig
# SPDX-License-Identifier: GPL-2.0
config MTK_CM_IPI
	tristate "MediaTek CM IPI over Tinysys SCMI"
	depends on MTK_TINYSYS_SCMI
	help
	  MediaTek CPU memory management firmware transport. The module is
	  mtk_cm_ipi.

config MTK_CM_MGR
	tristate "MediaTek CPU memory latency management"
	depends on MTK_CM_IPI && CPU_FREQ && TRACEPOINTS && INTERCONNECT
	help
	  Common CM manager code shared by the SoC-specific driver. The module
	  is mtk_cm_mgr.

config MTK_CM_MGR_MT6989
	tristate "MediaTek MT6989 CM manager"
	depends on MTK_CM_MGR && MTK_DVFSRC && MTK_DRAMC
	help
	  Manage MT6989 DRAM votes using the CM firmware interface and DVFSRC
	  interconnect. The module is mtk_cm_mgr_mt6989.
```

## drivers/misc/mediatek/dlpt/Kconfig
```kconfig
# SPDX-License-Identifier: GPL-2.0
config MTK_ROTHKO_DLPT
	tristate "MediaTek rothko dynamic loading current budget"
	depends on OF && IIO && MFD_MTK_SPMI_PMIC && MEDIATEK_MT6375_AUXADC
	default n
	help
	  Read the battery current budget on demand using the MT6363 charger
	  status and MT6375 AUXADC samples. The budget_ma platform device
	  attribute reports milliamps and is readable by root. This driver
	  does not apply limits or run periodic sampling.
```

## drivers/misc/mediatek/geniezone/Kconfig
```kconfig
config MTK_ENABLE_GENIEZONE
	tristate "MediaTek GenieZone Trusty transport"
	depends on ARCH_MEDIATEK && ARM64
	select TRUSTY_INTERRUPT_FIQ_ONLY

config TRUSTY_INTERRUPT_FIQ_ONLY
	bool

config MTK_GZ_IRQ
	tristate "MediaTek GenieZone Trusty interrupt forwarding"
	depends on MTK_ENABLE_GENIEZONE

config MTK_GZ_VIRTIO
	tristate "MediaTek GenieZone Trusty VirtIO transport"
	depends on MTK_ENABLE_GENIEZONE
	select VIRTIO

config MTK_GZ_VIRTIO_IPC
	tristate "MediaTek GenieZone Trusty VirtIO IPC"
	depends on MTK_GZ_VIRTIO

config MTK_GZ_TZ_SYSTEM
	tristate "MediaTek GenieZone Trusty session services"
	depends on MTK_GZ_VIRTIO_IPC && MTK_GZ_IRQ
```

## drivers/misc/mediatek/ise_lpm/Kconfig
```kconfig
# SPDX-License-Identifier: GPL-2.0

config MTK_ISE_LPM_SUPPORT
	tristate "Specify Interface Support iSE low power control"
	depends on MTK_TINYSYS_SCMI && OF
	help
	  support iSE power control
	  Set Y to enable this feature.
	  If unsure,
	  Set N to stay with legancy feature.
```

## drivers/misc/mediatek/mbraink/Kconfig
```kconfig
# SPDX-License-Identifier: GPL-2.0

config MTK_MBRAINK
	tristate "MediaTek MBrain battery telemetry"
	depends on GAUGE_MT6375
	help
	  Expose the MediaTek MBrain battery information ioctl backed by the
	  MT6375 fuel gauge.
```

## drivers/misc/mediatek/mdpm/Kconfig
```kconfig
# SPDX-License-Identifier: GPL-2.0
config MTK_MDPM
	bool "MediaTek MT6989 modem power meter"
	depends on MTK_ECCCI_DRIVER = y && PROC_FS
	default n
	help
	  Estimate modem power from the gen6298 CCCI DBM shared memory.
	  Reports the scenario and transmit power through /proc/mdpm/mdpm_power.
```

## drivers/misc/mediatek/performance/Kconfig
```kconfig
# SPDX-License-Identifier: GPL-2.0
config MTK_PERFORMANCE_MODULE
	bool "MediaTek performance ioctl transport"
	depends on PROC_FS && CPU_FREQ
	help
	  Expose the MediaTek perfmgr, ADPF and MAGT frame notification ABIs.

config MTK_FPSGO_V3
	bool "MediaTek FPSGO v3 frame governor"
	depends on MTK_PERFORMANCE_MODULE && ARM64 && CPU_FREQ && SMP
	depends on UCLAMP_TASK && TRACEPOINTS
	help
	  Enable the MediaTek frame composer, frame stabilizer, dependency
	  tracker and frame-based CPU tuner for MT6989.

config MTK_FPSGO_NATIVE_XGF
	bool "Native 6.18 XGF runtime estimator"
	depends on MTK_FPSGO_V3
	help
	  Estimate CPU runtime and dependency lists for the FPSGO frame
	  pipeline from scheduler events captured by the 6.18 kernel.

config MTK_FPSGO_DDR_RESCUE_DEFAULT
	bool "Enable DDR bandwidth votes for eligible frame rescue by default"
	depends on MTK_FPSGO_V3 && INTERCONNECT
	help
	  Enable first-stage frame rescue and its DDR vote by default. FBT requests peak
	  memory bandwidth during an eligible frame rescue and releases it
	  when the rescue ends. Userspace can change the flag in sysfs.
```

## drivers/misc/mediatek/rothko-irtx/Kconfig
```kconfig
# SPDX-License-Identifier: GPL-2.0
config MTK_ROTHKO_IRTX_PWM
	tristate "MediaTek MT6989 infrared PWM transmitter"
	depends on ARCH_MEDIATEK && OF && HAS_IOMEM && COMMON_CLK
	depends on PINCTRL && REGULATOR
	select MFD_SYSCON
	help
	  Support the original /dev/irtx interface and MT6989 PWM DMA engine.
```

## drivers/misc/mediatek/rothko-sensorhub/Kconfig
```kconfig
# SPDX-License-Identifier: GPL-2.0

config MTK_SENSOR_SUPPORT
	bool "MT6989 high frequency sensor manager"
	depends on ARM64 && OF
	help
	  Build the MediaTek high frequency sensor manager and its existing
	  hf_manager userspace ABI for the MT6989 sensor HAL.

config MTK_SENSORHUB
	bool "MT6989 SCP sensorhub"
	depends on MTK_SENSOR_SUPPORT && MTK_TINYSYS_SCP_SUPPORT
	help
	  Use the SCP sensor control and notification IPI channels, shared
	  memory rings and firmware-provided sensor list on MT6989.

config MTK_CONN_SCP
	bool "MT6989 connectivity SCP bridge"
	depends on MTK_SENSOR_SUPPORT && MTK_TINYSYS_SCP_SUPPORT && NET
	help
	  Build the conap SCP transport and the existing FLP, geofence and
	  aolextra interfaces using the MT6989 connection mailbox channels.
```

## drivers/misc/mediatek/rothko_modem/Kconfig
```kconfig
source "drivers/misc/mediatek/rothko_modem/ccci_util/Kconfig"
source "drivers/misc/mediatek/rothko_modem/eccci/Kconfig"
source "drivers/misc/mediatek/rothko_modem/ccmni/Kconfig"
source "drivers/misc/mediatek/rothko_modem/conn_md/Kconfig"
source "drivers/misc/mediatek/rothko_modem/memory-amms/Kconfig"
source "drivers/misc/mediatek/rothko_modem/rps/Kconfig"
```

## drivers/misc/mediatek/sspm/Kconfig
```kconfig
# SPDX-License-Identifier: GPL-2.0
config MTK_TINYSYS_SSPM_SUPPORT
	tristate "MediaTek SSPM v3 platform service"
	depends on ARM64 && OF_RESERVED_MEM && MTK_TINYSYS_SCMI
	help
	  Initialize SSPM shared memory and synchronize the SSPM clock on
	  MT6989. The module is sspm_v3.
```

## drivers/net/rothko_miwill/Kconfig
```kconfig
# SPDX-License-Identifier: GPL-2.0-only
config ROTHKO_MIWILL
	tristate "Rothko MiWiLL Ethernet redundancy"
	depends on INET
	help
	  Provide a MiWiLL virtual link for a configured pair of Wi-Fi ports
	  and a MiWiLL gateway in the initial network namespace.

	  To compile this driver as a module, choose M here: the module will
	  be called miwill. If unsure, say N.
```

## drivers/net/wireless/mediatek/rothko-conninfra/Kconfig
```kconfig
source "drivers/net/wireless/mediatek/rothko-conninfra/vendor/drivers/misc/mediatek/clkbuf/Kconfig"

config MTK_ROTHKO_CONNINFRA
	bool "MT6989 connection infrastructure"
	depends on ARCH_MEDIATEK && OF && NET
	select MTK_CLKBUF_CTRL
	select MTK_COMBO_CHIP_CONSYS_6989

config MTK_COMBO_CHIP_CONSYS_6989
	bool

config MTK_ROTHKO_CONNFEM
	bool "MT6989 connection front-end module"
	depends on MTK_ROTHKO_CONNINFRA

config MTK_ROTHKO_BT
	bool "MT6639 native Android Bluetooth UART driver"
	depends on MTK_ROTHKO_CONNINFRA && TTY && BT
	select MTK_ROTHKO_CONNFEM

config MTK_ROTHKO_WLAN
	bool "MT6639 PCIe WLAN for MT6989"
	depends on MTK_ROTHKO_CONNINFRA && PCI && CFG80211=y
	depends on PCIE_MEDIATEK_GEN3=y
	select MTK_ROTHKO_CONNFEM
	help
	  Build the MT6639 gen4m WLAN driver and its Android /dev/wmtWifi
	  control device. The driver also provides connv3 WLAN pre-calibration.

source "drivers/net/wireless/mediatek/rothko-conninfra/uarthub/Kconfig"

config MTK_ROTHKO_GPS_SCP
	bool "MT6989 GNSS to SCP transport"
	depends on MTK_ROTHKO_CONNINFRA && MTK_CONN_SCP

config MTK_ROTHKO_GPS_DATA_LINK
	bool "MT6989 GNSS CCIF/EMI data link"
	depends on ARM64 && MTK_ROTHKO_CONNINFRA
	default n
	help
	  Build the v061 MediaTek GNSS data link, including the MCU/CCIF
	  transport, GNSS storage channels and the separate ICAP device.

config MTK_ROTHKO_GPS_DATA_LINK_FW_LOADER
	bool "Allow the MT6989 GNSS driver to request firmware"
	depends on MTK_ROTHKO_GPS_DATA_LINK && FW_LOADER
	default n
	help
	  Enable the donor's explicit debug opt-in for loading GNSS firmware
	  files into the dedicated EMI slots. Leave this disabled unless the
	  board's firmware names and loading policy have been verified.
```

## drivers/net/wireless/mediatek/rothko-conninfra/uarthub/Kconfig
```kconfig
# SPDX-License-Identifier: GPL-2.0
config MTK_UARTHUB
	bool "MT6989 UART HUB"
	depends on MTK_ROTHKO_BT && SERIAL_8250_MT6577=y && COMMON_CLK
	help
	  Enable the MT6989 UART HUB routing and host ownership interface
	  used by the native MT6639 Bluetooth UART driver.
```

## drivers/nfc/rothko_thn31/Kconfig
```kconfig
config ROTHKO_THN31_NFC
	tristate "Rothko THN31 NFC and eSE transports"
	depends on I2C && SPI && GPIOLIB && OF && PINCTRL && PM
	help
	  Expose the THN31 I2C NFC and SPI eSE interfaces to the stock
	  Android HALs.
```

## drivers/pmdomain/mediatek/mt6989/Kconfig
```kconfig
# SPDX-License-Identifier: GPL-2.0-only
config MTK_SCPSYS_MT6989
	tristate "MediaTek MT6989 SCPSYS power domains"
	depends on ARCH_MEDIATEK || COMPILE_TEST
	depends on OF && PM_GENERIC_DOMAINS && COMMON_CLK && REGULATOR
	select MFD_SYSCON
	help
	  Support the MT6989 SPM and hardware-voter power domains, including
	  their bus protection, clocks, SRAM, retention and subdomain topology.
```

## drivers/power/supply/rothko-power-throttling/Kconfig
```kconfig
# SPDX-License-Identifier: GPL-2.0-only
config MTK_POWER_THROTTLING_COMMON
	bool "MTK MT6989 battery power throttling interfaces"
	depends on ARCH_MEDIATEK

config PMIC_LBAT_SERVICE
	bool "MediaTek PMIC battery voltage interrupt service"
	depends on REGMAP && IRQ_DOMAIN
	select MTK_POWER_THROTTLING_COMMON

config MTK_BATTERY_OC_POWER_THROTTLING
	bool "MediaTek PMIC battery overcurrent throttling"
	depends on REGMAP && IRQ_DOMAIN
	select MTK_POWER_THROTTLING_COMMON

config MTK_LOW_BATTERY_POWER_THROTTLING
	bool "MediaTek low battery voltage throttling"
	depends on POWER_SUPPLY && REGMAP && IRQ_DOMAIN
	select MTK_POWER_THROTTLING_COMMON
	select PMIC_LBAT_SERVICE
```

## drivers/power/supply/rothko-ppb/Kconfig
```kconfig
config MTK_PEAK_POWER_BUDGET
	tristate "MT6989 peak power budget"
	depends on POWER_SUPPLY && OF
	help
	  Publish camera, audio and display power requests to the MT6989
	  firmware SRAM and update the budget from the battery supply.
```

## drivers/soc/mediatek/Kconfig
```kconfig
# SPDX-License-Identifier: GPL-2.0-only
#
# MediaTek SoC drivers
#
menu "MediaTek SoC drivers"
	depends on ARCH_MEDIATEK || COMPILE_TEST

config MTK_CMDQ
	tristate "MediaTek CMDQ Support"
	depends on ARCH_MEDIATEK || COMPILE_TEST
	select MAILBOX
	select MTK_CMDQ_MBOX
	select MTK_INFRACFG
	help
	  Say yes here to add support for the MediaTek Command Queue (CMDQ)
	  driver. The CMDQ is used to help read/write registers with critical
	  time limitation, such as updating display configuration during the
	  vblank.

config MTK_DEVAPC
	tristate "Mediatek Device APC Support"
	help
	  Say yes here to enable support for Mediatek Device APC driver.
	  This driver is mainly used to handle the violation which catches
	  unexpected transaction.
	  The violation information is logged for further analysis or
	  countermeasures.

config MTK_DVFSRC
	tristate "MediaTek DVFSRC Support"
	depends on ARCH_MEDIATEK
	help
	  Say yes here to add support for the MediaTek Dynamic Voltage
	  and Frequency Scaling Resource Collector (DVFSRC): a HW
	  IP found on many MediaTek SoCs, which is responsible for
	  collecting DVFS requests from various SoC IPs, other than
	  software, and performing bandwidth scaling to provide the
	  best achievable performance-per-watt.

config MTK_ROTHKO_DDR_DEVFREQ
	bool "MT6989 DDR devfreq support for Rothko"
	depends on MTK_DVFSRC=y && MTK_DRAMC=y && PM_OPP && DEVFREQ_GOV_USERSPACE=y
	help
	  Expose firmware-provided DDR gears and allow devfreq to request a
	  minimum DDR gear through the MT6989 DVFSRC.

config MTK_INFRACFG
	tristate "MediaTek INFRACFG Support"
	select REGMAP
	help
	  Say yes here to add support for the MediaTek INFRACFG controller. The
	  INFRACFG controller contains various infrastructure registers not
	  directly associated to any device.

config MTK_PMIC_WRAP
	tristate "MediaTek PMIC Wrapper Support"
	depends on RESET_CONTROLLER
	depends on OF
	select REGMAP
	help
	  Say yes here to add support for MediaTek PMIC Wrapper found
	  on different MediaTek SoCs. The PMIC wrapper is a proprietary
	  hardware to connect the PMIC.

config MTK_REGULATOR_COUPLER
	bool "MediaTek SoC Regulator Coupler" if COMPILE_TEST
	default ARCH_MEDIATEK
	depends on REGULATOR

config MTK_MMSYS
	tristate "MediaTek MMSYS Support"
	default ARCH_MEDIATEK
	depends on HAS_IOMEM
	depends on MTK_CMDQ || MTK_CMDQ=n
	help
	  Say yes here to add support for the MediaTek Multimedia
	  Subsystem (MMSYS).

config MTK_SVS
	tristate "MediaTek Smart Voltage Scaling(SVS)"
	depends on NVMEM_MTK_EFUSE && NVMEM
	help
	  The Smart Voltage Scaling(SVS) engine is a piece of hardware
	  which has several controllers(banks) for calculating suitable
	  voltage to different power domains(CPU/GPU/CCI) according to
	  chip process corner, temperatures and other factors. Then DVFS
	  driver could apply SVS bank voltage to PMIC/Buck.

config MTK_SOCINFO
	tristate "MediaTek SoC Information"
	default y
	depends on NVMEM_MTK_EFUSE
	select SOC_BUS
	help
	  The MediaTek SoC Information (mtk-socinfo) driver provides
	  information about the SoC to the userspace including the
	  manufacturer name, marketing name and soc name.

config MTK_ROTHKO_SOCINFO
	bool "MT6989 SoC information for rothko"
	depends on ARCH_MEDIATEK && OF
	select SOC_BUS
	help
	  Expose the MT6989 SoC family and ID for the stock rothko chipinfo
	  service before Android early-init.

config MTK_ROTHKO_MCUPM
	bool "MT6989 MCUPM platform timesync for rothko"
	depends on ARCH_MEDIATEK && ARM64 && OF && ARM_ARCH_TIMER && MTK_MBOX
	help
	  Probe the running MCUPM with its platform Alive IPI and maintain the
	  AP time base in the shared mailbox on the Xiaomi rothko board.
	  Enable this only for a dedicated rothko kernel build.

endmenu
```

## drivers/tee/mt6989/Kconfig
```kconfig
# SPDX-License-Identifier: GPL-2.0
config MTK_MITEE
 tristate "Xiaomi MT6989 MiTEE over FF-A"
 depends on ARM64 && ARM_FFA_TRANSPORT && TEE && !OPTEE
 depends on RPMB || !RPMB
 help
   MiTEE ioctl and Xiaomi FF-A physical message ABI used by rothko.
```
