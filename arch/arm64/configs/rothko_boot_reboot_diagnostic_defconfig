## drivers/dma-buf/heaps/mt6989/Kconfig
```kconfig
# SPDX-License-Identifier: GPL-2.0
config DEVICE_MODULES_DMABUF_HEAPS_SYSTEM
    tristate "MT6989 DMA-BUF system and multimedia heaps"
    depends on DMABUF_HEAPS

config DEVICE_MODULES_DMABUF_HEAPS_REFILL
    tristate "MT6989 DMA-BUF heap refill"
    depends on DEVICE_MODULES_DMABUF_HEAPS_SYSTEM

config DMABUF_HEAPS_DEBUG
    tristate "MT6989 DMA-BUF debug heap"
    depends on DEVICE_MODULES_DMABUF_HEAPS_SYSTEM
```

## drivers/firmware/arm_scmi/Kconfig.tinysys
```kconfig
# SPDX-License-Identifier: GPL-2.0
config MTK_TINYSYS_SCMI
	tristate "MediaTek Tinysys SCMI protocol 0x80"
	depends on ARM_SCMI_PROTOCOL && OF
	depends on ARM_SCMI_TRANSPORT_MAILBOX
	depends on ARCH_MEDIATEK || COMPILE_TEST
	help
	  MT6989 vendor Tinysys SET, GET and feature notification protocol.
	  The module is tinysys-scmi. It uses the SCMI mailbox transport
	  and exports the original MediaTek client operations.
```

## drivers/gpu/drm/mediatek/mt6989/Kconfig
```kconfig
# SPDX-License-Identifier: GPL-2.0
config DRM_MEDIATEK_MT6989
	tristate "MediaTek MT6989 mobile display controller"
	depends on DRM && OF && COMMON_CLK && MMU
	select DRM_KMS_HELPER
	select DRM_DISPLAY_HELPER
	select DRM_DISPLAY_DP_HELPER
	select DRM_MIPI_DSI
	select DRM_GEM_DMA_HELPER
	select SYNC_FILE
	select MTK_MML
	select MTK_DPC
	select MTK_CMDQ_MBOX_EXT
	help
	  MediaTek V2 DRM/DSI/DSC/MIPI TX implementation for MT6989.
	  Uses the original vendor command-queue, display/MML paths and UAPI.

source "drivers/gpu/drm/mediatek/mt6989/mediatek_v2/Kconfig"

config DRM_ROTHKO_N12
	bool "Redmi K70 Ultra N12 42/02/0a and 36/02/0b panels and Novatek VIS"
	depends on DRM_MEDIATEK_MT6989=y && ROTHKO_HWID
	depends on SPI_MT65XX=y && SPI_MEM && GPIOLIB_LEGACY
	depends on COMMON_CLK_MT6685_335=y && BACKLIGHT_CLASS_DEVICE=y
	help
	  Build the N12 command-mode DSI panel and its Novatek VIS SPI
	  controller for Redmi K70 Ultra (rothko).

source "drivers/gpu/drm/mediatek/mt6989/mml/Kconfig"
source "drivers/gpu/drm/mediatek/mt6989/dpc/Kconfig"

config MTK_CMDQ_MBOX_EXT
	tristate "MT6989 hardware CMDQ mailbox extension"
	depends on MAILBOX && ARM64

config MTK_MDP_MT6989
	bool "MT6989 Media Data Path for Android Codec2"
	depends on DRM_MEDIATEK_MT6989=y && MTK_CMDQ_MBOX_EXT=y
	depends on MTK_MMDVFS=y && INTERCONNECT_MTK_EXTENSION=y
	select SYNC_FILE
	help
	  Enable the MT6989 MDP command queue and sync timelines used by
	  Android's hardware video decoder for output format conversion.

source "drivers/gpu/drm/mediatek/mt6989/vendor/drivers/misc/mediatek/mminfra/Kconfig"
source "drivers/gpu/drm/mediatek/mt6989/vendor/drivers/misc/mediatek/mmp/Kconfig"
source "drivers/gpu/drm/mediatek/mt6989/vendor/drivers/misc/mediatek/mtk-interconnect/Kconfig"
source "drivers/gpu/drm/mediatek/mt6989/vendor/drivers/misc/mediatek/slbc/Kconfig"

config MTK_MMDVFS
	tristate "MT6989 multimedia DVFS"
	depends on ARCH_MEDIATEK && REGULATOR_MTK_DVFSRC

config DEVICE_MODULES_MTK_SMI
	tristate "MT6989 vendor SMI bus controller"
	depends on ARCH_MEDIATEK && OF

source "drivers/gpu/drm/mediatek/mt6989/vendor/drivers/misc/mediatek/vcp/Kconfig"

source "drivers/gpu/drm/mediatek/mt6989/leds/Kconfig"
```

## drivers/gpu/drm/mediatek/mt6989/leds/Kconfig
```kconfig
# SPDX-License-Identifier: GPL-2.0-only
if NEW_LEDS

config LEDS_MTK
	tristate "Mediatek COMMON LED support"
	depends on LEDS_CLASS
	help
	  This option enables support for Mediatek common LEDs
	  say 'y' to enable this

	  To compile this driver as a module, choose 'M' here: the module
	  will be called leds-mtk.

config LEDS_MTK_DISP
	tristate "Mediatek DISP LED support"
	depends on LEDS_CLASS && LEDS_MTK
	depends on MTK_CMDQ_MBOX_EXT
	help
	  This option enables support for Mediatek OLED Display LEDs
	  say 'y' to enable this

	  To compile this driver as a module, choose 'M' here: the module
	  will be called leds-mtk-disp.

endif
```

## drivers/gpu/drm/mediatek/mt6989/vendor/drivers/misc/mediatek/mminfra/Kconfig
```kconfig
# SPDX-License-Identifier: GPL-2.0

config MTK_MMINFRA
	tristate "MediaTek MMInfra driver"
	depends on ARCH_MEDIATEK || COMPILE_TEST
	help
	  This driver is for the Multimedia Infrastructure in MediaTek SoCs.
	  The MMINFRA driver mainly help control power, clock and security setting
	  for the bus of multimedia users, such as display, camera, mdp and video
	  codec. The MMINFRA driver also provide backup and restore function for
	  registers located in the same power domain.

config MTK_MT6989_SMMU_SHARE_GROUP
	bool "MediaTek MT6989 shared SMMU DMA devices"
	depends on DEVICE_MODULES_ARM_SMMU_V3=y
	depends on !MTK_MMINFRA
	help
	  Bind the MediaTek shared stream devices to the standard platform DMA
	  and IOMMU setup without enabling the unrelated MMInfra debug drivers.

config MTK_MMINFRA_DEBUG
	tristate "MediaTek MMInfra driver debug"
	depends on MTK_MMINFRA
	help
	  This extension enables debug features for MMINFRA driver. We only default
	  enable this in userdebug/eng load. With this extension enabled, you
	  can use adb command to dynamically do MMINFRA debug items. This extension
	  is by default disabled on user load for security concern.
```

## drivers/input/misc/rothko_aw8697/Kconfig
```kconfig
config ROTHKO_AW8697_HAPTIC
	tristate "Rothko AW86927 haptic controller"
	depends on I2C && INPUT && GPIOLIB && OF && PINCTRL
	select REGMAP_I2C
	select FW_LOADER
	help
	  Enable force feedback for the Awinic AW86927 on stock Rothko.
```

## drivers/input/touchscreen/rothko/ft3683/Kconfig
```kconfig
config TOUCHSCREEN_FT3683_ROTHKO
	tristate "Redmi K70 Ultra Focaltech FT3683 SPI touchscreen"
	depends on SPI && GPIOLIB && REGULATOR && PINCTRL
	select XIAOMI_TOUCH_COMMON_ROTHKO
	help
	  Focaltech FT3683 found in Redmi K70 Ultra touch panel variants.
	  Supports the original Xiaomi SPI node, chip identification and
	  the original normal and super resolution multi-touch reports.

config XIAOMI_TOUCH_COMMON_ROTHKO
	tristate "Xiaomi touch v3 transport"
	help
	  Controller-backed Xiaomi touch status and v3 request dispatch.
	  Operations without a controller implementation return EOPNOTSUPP.
```

## drivers/mailbox/Kconfig.tinysys
```kconfig
# SPDX-License-Identifier: GPL-2.0
config MTK_TINYSYS_MBOX
	tristate "MediaTek Tinysys SCMI mailbox"
	depends on MAILBOX
	depends on ARM64 && OF
	depends on ARCH_MEDIATEK || COMPILE_TEST
	help
	  Two-channel MT6989 Tinysys doorbell controller for SCMI shared
	  memory, including SSPM secure interrupt clearing.
```

## drivers/media/platform/mediatek/jpeg/Kconfig
```kconfig
# SPDX-License-Identifier: GPL-2.0-only
config VIDEO_MEDIATEK_JPEG
	tristate "Mediatek JPEG Codec driver"
	depends on V4L_MEM2MEM_DRIVERS
	depends on ((MTK_IOMMU_V1 || MTK_IOMMU) && MTK_SMI) || \
		   (COMPILE_TEST && MTK_SMI=n) || \
		   (DEVICE_MODULES_ARM_SMMU_V3 && DEVICE_MODULES_MTK_SMI && \
		    MTK_MT6989_SMMU_SHARE_GROUP && MTK_MMDVFS && \
		    INTERCONNECT_MTK_EXTENSION)
	depends on MTK_MMDVFS || !MTK_MMDVFS
	depends on INTERCONNECT_MTK_EXTENSION || !INTERCONNECT_MTK_EXTENSION
	depends on VIDEO_DEV
	depends on ARCH_MEDIATEK || COMPILE_TEST
	select VIDEOBUF2_DMA_CONTIG
	select V4L2_MEM2MEM_DEV
	select PM_OPP if MTK_MMDVFS
	help
	  MediaTek hardware JPEG encoding and decoding. MT6989 encoding uses
	  the vendor SMMU, SMI, MMDVFS and interconnect providers.

	  As modules, this builds mtk_jpeg, mtk-jpeg-enc-hw and
	  mtk-jpeg-dec-hw.
```

## drivers/media/platform/mediatek/rothko-camera/Kconfig
```kconfig
# SPDX-License-Identifier: GPL-2.0-only
config VIDEO_ROTHKO_CAMERA
	bool "Redmi K70 Ultra MT6989 camera ISP7SP"
	depends on VIDEO_DEV && MEDIA_CONTROLLER && I2C && REMOTEPROC && RPMSG
	depends on MTK_MMDVFS && MTK_SLBC && MTK_IOMMU_MISC_SECURE
	select VIDEO_V4L2_SUBDEV_API
	select V4L2_FWNODE
	select V4L2_ASYNC
	select VIDEOBUF2_DMA_CONTIG
	select RPMSG_MTK_CCD
	select MTK_CCD_REMOTEPROC
	select MTK_CCU_RPROC
	select VIDEO_MTK_ISP_CAMSYS
	select MTK_V4L2_IMGSENSOR
	help
	  Original MT6989 RAW/YUV/MRAW, seninf CSI, CCD and CCU camera drivers.
	  Xiaomi board sensor drivers are selected with CUSTOM_KERNEL_IMGSENSOR.

config RPMSG_MTK_CCD
	bool

config MTK_CCD_REMOTEPROC
	bool

config MTK_CCU_RPROC
	bool

config VIDEO_MTK_ISP_CAMSYS
	bool

config MTK_V4L2_IMGSENSOR
	bool

config CUSTOM_KERNEL_IMGSENSOR
	string "Xiaomi board sensor driver list"
	depends on VIDEO_ROTHKO_CAMERA
	default ""

config VIDEO_ROTHKO_CAMERA_AF
	tristate "rothko autofocus media device and lens actuators"
	depends on VIDEO_ROTHKO_CAMERA && OF && REGULATOR
	help
	  Enable the board's autofocus media graph and the two I2C voice
	  coil actuators controlled through the MediaTek lens V4L2 ABI.

config VIDEO_ROTHKO_CAMERA_PDA
	tristate "rothko MT6989 phase-detection autofocus accelerator"
	depends on VIDEO_ROTHKO_CAMERA && OF && PM && DMA_SHARED_BUFFER
	depends on DEVICE_MODULES_ARM_SMMU_V3 && MTK_MT6989_SMMU_SHARE_GROUP
	depends on DEVICE_MODULES_MTK_SMI && INTERCONNECT_MTK_EXTENSION
	help
	  Enable the paired ISP7SP PDA engines and their MediaTek userspace ABI.

config VIDEO_ROTHKO_CAMERA_DPE
	tristate "rothko MT6989 ISP7SP depth processing engine"
	depends on VIDEO_ROTHKO_CAMERA && OF && PM && DMA_SHARED_BUFFER
	depends on DEVICE_MODULES_ARM_SMMU_V3 && MTK_MT6989_SMMU_SHARE_GROUP
	depends on DEVICE_MODULES_MTK_SMI && MTK_CMDQ_MBOX_EXT
	help
	  Enable the DVS, DVP and DVGF blocks and their MediaTek userspace ABI.

config VIDEO_ROTHKO_CAMERA_EEPROM
	tristate "Rothko camera EEPROM calibration"
	depends on VIDEO_ROTHKO_CAMERA && OF && I2C
	help
	  Expose the stock camera_eeprom device nodes and read-only
	  calibration interface for the Rothko camera modules.

config VIDEO_ROTHKO_CAMERA_TORCH
	bool "Rothko OCP81373/SGM37ET1 camera torch"
	depends on VIDEO_ROTHKO_CAMERA && I2C=y && OF && THERMAL=y
	depends on MTK_PEAK_POWER_BUDGET=y
	select REGMAP_I2C
	help
	  Expose continuous torch operation through the stock MediaTek
	  flashlight character device and V4L2 flash media graph.

config VIDEO_ROTHKO_CAMERA_COMPOSITE
	tristate
	default y if VIDEO_ROTHKO_CAMERA_TORCH
	default VIDEO_ROTHKO_CAMERA_AF
```

## drivers/media/platform/mediatek/rothko-imgsys/Kconfig
```kconfig
# SPDX-License-Identifier: GPL-2.0-only
config VIDEO_MTK_ISP_HCP
	tristate "MediaTek MT6989 ISP7SP hetero control processor"
	depends on VIDEO_DEV && OF && DEVICE_MODULES_ARM_SMMU_V3
	depends on DEVICE_MODULES_DMABUF_HEAPS_SYSTEM
	select VIDEOBUF2_DMA_CONTIG
	help
	  HCP daemon interface and ISP7SP working buffers for MT6989.

config VIDEO_MTK_ISP_IMGSYS_7SP
	bool "MediaTek MT6989 ISP7SP image system"
	depends on VIDEO_MTK_ISP_HCP=y && MEDIA_CONTROLLER
	depends on MTK_CMDQ_MBOX_EXT && DEVICE_MODULES_MTK_SMI
	depends on MTK_MMDVFS && MTK_TINYSYS_VCP_SUPPORT
	depends on INTERCONNECT_MTK_EXTENSION
	select VIDEOBUF2_DMA_SG
	help
	  ISP7SP V4L2 request pipeline, CMDQ execution and ISP hardware modules.

source "drivers/media/platform/mediatek/rothko-imgsys/vendor/drivers/interconnect/mediatek/Kconfig"
```

## drivers/media/platform/mediatek/rothko-imgsys/vendor/drivers/interconnect/mediatek/Kconfig
```kconfig
# SPDX-License-Identifier: GPL-2.0-only
config INTERCONNECT_MTK_MMQOS_COMMON
	tristate "MediaTek multimedia QoS core"
	depends on INTERCONNECT && ARCH_MEDIATEK
	depends on DEVICE_MODULES_MTK_SMI && MTK_MMDVFS && MTK_DRAMC
	select INTERCONNECT_MTK_EXTENSION

config MTK_MMQOS_VCP
	bool "MediaTek multimedia QoS VCP protocol"
	depends on INTERCONNECT_MTK_MMQOS_COMMON && MTK_TINYSYS_VCP_SUPPORT

config INTERCONNECT_MTK_MMQOS_MT6989
	tristate "MediaTek MT6989 multimedia QoS provider"
	depends on INTERCONNECT_MTK && DEVICE_MODULES_MTK_SMI
	select INTERCONNECT_MTK_MMQOS_COMMON

config INTERCONNECT_MTK_EMI
	tristate "MediaTek DVFSRC EMI bandwidth provider"
	depends on INTERCONNECT_MTK && MTK_DVFSRC && OF
```

## drivers/media/platform/mediatek/rothko-jpeg/Kconfig
```kconfig
# SPDX-License-Identifier: GPL-2.0-only
config VIDEO_ROTHKO_JPEG
	tristate "MediaTek MT6989 JPEG hybrid decoder"
	depends on OF && PM && DMA_SHARED_BUFFER && DMABUF_HEAPS
	depends on MTK_TINYSYS_VCP_SUPPORT && DEVICE_MODULES_MTK_SMI
	depends on DRM_MEDIATEK_MT6989 && DEVICE_MODULES_ARM_SMMU_V3
	depends on DEVICE_MODULES_DMABUF_HEAPS_SYSTEM && MTK_MMDVFS
	select PM_OPP
	help
	  Build the vendor JPEG hybrid decoder and its /proc/mtk_jpeg
	  userspace ioctl ABI for the MT6989 jpgdec and jpgdec_c1 devices.
```

## drivers/media/platform/mediatek/rothko-vcodec/Kconfig
```kconfig
# SPDX-License-Identifier: GPL-2.0-only
config VIDEO_ROTHKO_VENC
	bool "MT6989 VCP video encoder"
	depends on ARCH_MEDIATEK && VIDEO_DEV
	depends on DRM_MEDIATEK_MT6989 && DEVICE_MODULES_ARM_SMMU_V3
	depends on MTK_TINYSYS_VCP_SUPPORT && DEVICE_MODULES_MTK_SMI
	select VIDEOBUF2_DMA_CONTIG
	select V4L2_MEM2MEM_DEV
	help
	  Build the MT6989 vendor V4L2 encoder and its VCP firmware interface.
	  The Codec2 private controls and DMA buffer ABI are kept local to
	  this driver. This does not enable the upstream SCP/VPU codec.
```

## drivers/media/platform/mediatek/rothko-vdec/Kconfig
```kconfig
# SPDX-License-Identifier: GPL-2.0-only
config VIDEO_ROTHKO_VDEC
	bool "MediaTek MT6989 VCP hardware video decoder"
	depends on VIDEO_DEV && VIDEO_ROTHKO_VENC
	depends on MTK_TINYSYS_VCP_SUPPORT && DEVICE_MODULES_MTK_SMI
	depends on ARCH_MEDIATEK && DRM_MEDIATEK_MT6989 && DEVICE_MODULES_ARM_SMMU_V3
	select VIDEOBUF2_DMA_CONTIG
	select V4L2_MEM2MEM_DEV
	help
	  Enable the MT6989 VCP decoder using its firmware IPI, hardware IRQ,
	  DMA-BUF queues and vendor SMMU/SMI interfaces. The common codec and
	  DVFS objects are supplied by the existing rothko codec integration.
```
